## config/west.yml
```yaml
manifest:
  remotes:
    - name: zmkfirmware
      url-base: https://github.com/zmkfirmware
    - name: badjeff
      url-base: https://github.com/badjeff
    - name: pite1222
      url-base: https://github.com/pite1222
    - name: 4mplelab
      url-base: https://github.com/4mplelab
  projects:
    - name: zmk
      remote: pite1222
      revision: feat/pointing-studio
      import: app/west.yml
    - name: zmk-studio-messages
      remote: pite1222
      revision: feat/pointing
      path: modules/msgs/zmk-studio-messages
    - name: zmk-pmw3610-driver
      remote: badjeff
      revision: main
    - name: zmk-rgbled-widget
      remote: pite1222
      revision: critical-steady-light-zephyr41
    - name: zmk-feature-charge-indicator
      remote: 4mplelab
      revision: main
  self:
    path: config
```
